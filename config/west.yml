## config/west.yml
```yaml
manifest:
  remotes:
    - name: zmkfirmware
      url-base: https://github.com/zmkfirmware
    # dongle_display
    # - name: englmaxi
      # url-base: https://github.com/englmaxi
    # nice_oled - nice_epaper - dongle_display!view - oled Adapter
    - name: mctechnology17
      url-base: https://github.com/mctechnology17
    # prospector
    # - name: carrefinho                            # <--- add this
    # url-base: https://github.com/carrefinho     # <--- and this
    - name: prospector
      url-base: https://github.com/t-ogura
    - name: halfdane
      url-base: https://github.com/halfdane
    - name: ssbb
      url-base: https://github.com/ssbb
    - name: kot149
      url-base: https://github.com/kot149
  projects:
    - name: zmk
      remote: zmkfirmware
      revision: v0.3.0
      import: app/west.yml
    # dongle_display
    # - name: zmk-dongle-display
    #   remote: englmaxi
    #   revision: main
    # nice_oled - nice_epaper
    - name: zmk-nice-oled
      remote: mctechnology17
      revision: main
    # dongle_display!view
    # - name: zmk-dongle-display-view
    #   remote: mctechnology17
    #   revision: main
    # oled Adapter
    - name: zmk-oled-adapter
      remote: mctechnology17
      revision: main
    # prospector
    - name: prospector-zmk-module                 # <--- and these
      remote: prospector                          # <---
      revision: v2.0.0                            # <---  self:
      path: modules/prospector-zmk-module
  self:
    path: config
```
